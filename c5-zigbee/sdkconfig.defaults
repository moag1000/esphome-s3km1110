## c5-zigbee/sdkconfig.defaults
```kconfig
# ============================================================================
# ESP32-C5 Zigbee UART Coordinator - SDK Configuration
# ============================================================================
# Stripped-down config: Zigbee + UART only, no WiFi/BT/ESPHome/OTA

# Target
CONFIG_IDF_TARGET="esp32c5"

# Flash
CONFIG_ESPTOOLPY_FLASHSIZE_16MB=y
CONFIG_PARTITION_TABLE_CUSTOM=y
CONFIG_PARTITION_TABLE_CUSTOM_FILENAME="partitions.csv"

# CPU
CONFIG_ESP32C5_DEFAULT_CPU_FREQ_240=y

# PSRAM (8MB on Waveshare N16R8)
CONFIG_SPIRAM=y
CONFIG_SPIRAM_MODE_QUAD=y
CONFIG_SPIRAM_SPEED_80M=y

# ============================================================================
# Zigbee Configuration
# ============================================================================
CONFIG_ZB_ENABLED=y
CONFIG_ZB_COORDINATOR=y
CONFIG_ZB_RADIO_NATIVE=y
CONFIG_ZB_ZED_TIMEOUT=7

# ============================================================================
# Disable WiFi and Bluetooth (not needed for UART coordinator)
# ============================================================================
CONFIG_ESP_WIFI_ENABLED=n
CONFIG_BT_ENABLED=n

# ============================================================================
# Console — UART0 primary, USB-Serial-JTAG secondary (same as working project)
# ============================================================================
CONFIG_ESP_CONSOLE_UART_DEFAULT=y
CONFIG_ESP_CONSOLE_SECONDARY_USB_SERIAL_JTAG=y

# ============================================================================
# UART Configuration
# ============================================================================
# UART0 = free (TXD/RXD pins)
# UART1 = Bridge to ESP32-S3 (IO6=RX, IO7=TX, 115200 baud)

# ============================================================================
# System Configuration
# ============================================================================
CONFIG_ESP_TASK_WDT_TIMEOUT_S=10
CONFIG_ESP_MAIN_TASK_STACK_SIZE=6144
CONFIG_COMPILER_OPTIMIZATION_SIZE=y
CONFIG_ESP_SYSTEM_PANIC_PRINT_REBOOT=y
CONFIG_FREERTOS_HZ=100

# Stack overflow detection
CONFIG_FREERTOS_CHECK_STACKOVERFLOW_CANARY=y

# ============================================================================
# Logging
# ============================================================================
CONFIG_LOG_DEFAULT_LEVEL_INFO=y
CONFIG_LOG_MAXIMUM_LEVEL_DEBUG=y

# ============================================================================
# NVS
# ============================================================================
CONFIG_NVS_ENCRYPTION=n
```

## c5plus-zigbee/main/Kconfig.projbuild
```kconfig
menu "C5+ Zigbee Coordinator"

    menu "WiFi Configuration"
        config WIFI_SSID
            string "WiFi SSID"
            default "myssid"
            help
                WiFi network name (SSID) to connect to.

        config WIFI_PASSWORD
            string "WiFi Password"
            default "mypassword"
            help
                WiFi password for the network.

        config WIFI_MAX_RETRY
            int "Maximum retry attempts"
            default 10
            help
                Number of times to retry connecting to WiFi before giving up.
    endmenu

    menu "mDNS Configuration"
        config MDNS_HOSTNAME
            string "mDNS Hostname"
            default "c5plus-zigbee"
            help
                Hostname for mDNS discovery (accessible as hostname.local).
    endmenu

    menu "Device Configuration"
        config DEVICE_NAME
            string "Device Name"
            default "ESP32-C5+ Zigbee Coordinator"
            help
                Human-readable device name for logging and discovery.
    endmenu

endmenu
```

## c5plus-zigbee/sdkconfig.defaults
```kconfig
# ============================================================================
# ESP32-C5+ Zigbee + WiFi Coordinator - SDK Configuration
# ============================================================================
# Full-featured coordinator with WiFi 6 connectivity

# Target
CONFIG_IDF_TARGET="esp32c5"

# Flash
CONFIG_ESPTOOLPY_FLASHSIZE_16MB=y
CONFIG_PARTITION_TABLE_CUSTOM=y
CONFIG_PARTITION_TABLE_CUSTOM_FILENAME="partitions_ota.csv"

# CPU
CONFIG_ESP32C5_DEFAULT_CPU_FREQ_240=y

# ============================================================================
# PSRAM Configuration (8MB on Waveshare N16R8) - Optimized for Performance
# ============================================================================
CONFIG_SPIRAM=y
CONFIG_SPIRAM_MODE_QUAD=y
CONFIG_SPIRAM_SPEED_80M=y

# Use PSRAM aggressively
CONFIG_SPIRAM_USE_MALLOC=y
CONFIG_SPIRAM_MALLOC_ALWAYSINTERNAL=4096
CONFIG_SPIRAM_MALLOC_RESERVE_INTERNAL=32768
CONFIG_SPIRAM_ALLOW_BSS_SEG_EXTERNAL_MEMORY=y
CONFIG_SPIRAM_ALLOW_STACK_EXTERNAL_MEMORY=y

# WiFi/Network buffers in PSRAM
CONFIG_SPIRAM_TRY_ALLOCATE_WIFI_LWIP=y

# ============================================================================
# WiFi Configuration (WiFi 6 - 5GHz preferred for Zigbee coexistence)
# ============================================================================
CONFIG_ESP_WIFI_ENABLED=y
CONFIG_ESP_WIFI_STATIC_RX_BUFFER_NUM=10
CONFIG_ESP_WIFI_DYNAMIC_RX_BUFFER_NUM=32
CONFIG_ESP_WIFI_DYNAMIC_TX_BUFFER_NUM=32
CONFIG_ESP_WIFI_AMPDU_TX_ENABLED=y
CONFIG_ESP_WIFI_AMPDU_RX_ENABLED=y

# WiFi 6 features
CONFIG_SOC_WIFI_HE_SUPPORT=y

# 5GHz Band preferred (avoids 2.4GHz interference with Zigbee)
CONFIG_ESP_WIFI_11KV_SUPPORT=y
CONFIG_ESP_WIFI_SCAN_ALLOW_5G_BANDS=y

# WiFi/Zigbee Coexistence
CONFIG_ESP_COEX_SW_COEXIST_ENABLE=y

# WiFi Credentials (same as S3, using DHCP)
# IMPORTANT: Set actual values in sdkconfig.local (gitignored)!
CONFIG_WIFI_SSID="your_ssid"
CONFIG_WIFI_PASSWORD="your_password"
CONFIG_WIFI_MAX_RETRY=10

# mDNS
CONFIG_MDNS_HOSTNAME="c5plus-zigbee"
CONFIG_DEVICE_NAME="ESP32-C5+ Zigbee Coordinator"

# ============================================================================
# Zigbee Configuration
# ============================================================================
CONFIG_ZB_ENABLED=y
CONFIG_ZB_COORDINATOR=y
CONFIG_ZB_RADIO_NATIVE=y
CONFIG_ZB_ZED_TIMEOUT=7

# Zigbee network settings (channel 11 - best device compatibility)
CONFIG_ZIGBEE_CHANNEL=11
CONFIG_ZIGBEE_PAN_ID=0x1A62

# ============================================================================
# Bluetooth disabled (not needed, saves memory)
# ============================================================================
CONFIG_BT_ENABLED=n

# ============================================================================
# Console — UART0 primary, USB-Serial-JTAG secondary
# ============================================================================
CONFIG_ESP_CONSOLE_UART_DEFAULT=y
CONFIG_ESP_CONSOLE_SECONDARY_USB_SERIAL_JTAG=y

# ============================================================================
# UART Configuration
# ============================================================================
# UART0 = Console (TXD/RXD pins)
# UART1 = Bridge to ESP32-S3 (IO6=RX, IO7=TX, 115200 baud)

# ============================================================================
# System Configuration
# ============================================================================
CONFIG_ESP_TASK_WDT_TIMEOUT_S=10
CONFIG_ESP_MAIN_TASK_STACK_SIZE=8192
CONFIG_COMPILER_OPTIMIZATION_SIZE=y
CONFIG_ESP_SYSTEM_PANIC_PRINT_REBOOT=y
CONFIG_FREERTOS_HZ=100

# Stack overflow detection
CONFIG_FREERTOS_CHECK_STACKOVERFLOW_CANARY=y

# ============================================================================
# Logging
# ============================================================================
CONFIG_LOG_DEFAULT_LEVEL_INFO=y
CONFIG_LOG_MAXIMUM_LEVEL_DEBUG=y

# ============================================================================
# NVS
# ============================================================================
CONFIG_NVS_ENCRYPTION=n

# ============================================================================
# LWIP (for WiFi)
# ============================================================================
CONFIG_LWIP_LOCAL_HOSTNAME="c5plus-zigbee"
CONFIG_LWIP_DHCP_DOES_ARP_CHECK=y
```

## components/esp_zb_coordinator/Kconfig
```kconfig
menu "Zigbee Coordinator Configuration"

    menu "GPIO Pin Configuration"

        config ZB_UART_TX_PIN
            int "UART TX GPIO pin"
            default 7 if IDF_TARGET_ESP32C5
            default 24 if IDF_TARGET_ESP32H2
            default 7
            range -1 48
            help
                GPIO pin for UART TX (coordinator → S3).
                C5 default: GPIO7, H2 default: GPIO24

        config ZB_UART_RX_PIN
            int "UART RX GPIO pin"
            default 6 if IDF_TARGET_ESP32C5
            default 23 if IDF_TARGET_ESP32H2
            default 6
            range -1 48
            help
                GPIO pin for UART RX (S3 → coordinator).
                C5 default: GPIO6, H2 default: GPIO23

        config ZB_LED_GPIO
            int "Status LED GPIO pin"
            default 8 if IDF_TARGET_ESP32C5
            default -1 if IDF_TARGET_ESP32H2
            default -1
            range -1 48
            help
                GPIO pin for WS2812 status LED. Set to -1 to disable.
                C5 default: GPIO8 (Waveshare board), H2: -1 (no LED)

    endmenu

    config ZB_MAX_DEVICES
        int "Maximum Zigbee devices"
        default 64 if IDF_TARGET_ESP32C5
        default 32 if IDF_TARGET_ESP32H2
        default 32
        range 8 128
        help
            Maximum number of Zigbee devices that can join the network.
            Larger values require more RAM. H2 should use smaller values.

    config ZB_MAX_CHILDREN
        int "Maximum direct children"
        default 32 if IDF_TARGET_ESP32C5
        default 16 if IDF_TARGET_ESP32H2
        default 16
        range 4 64
        help
            Maximum number of direct children (end devices) the coordinator
            can support. Routers don't count against this limit.

    config ZB_COORDINATOR_STACK_SIZE
        int "Coordinator task stack size"
        default 6144 if IDF_TARGET_ESP32C5
        default 4096 if IDF_TARGET_ESP32H2
        default 4096
        range 3072 8192
        help
            Stack size for the Zigbee coordinator task in bytes.
            C5 can use larger stacks; H2 should be conservative.

    config ZB_AVAILABILITY_STACK_SIZE
        int "Availability task stack size"
        default 4096 if IDF_TARGET_ESP32C5
        default 3072 if IDF_TARGET_ESP32H2
        default 3072
        range 2048 6144
        help
            Stack size for the availability tracking task.

    config ZB_UART_RX_STACK_SIZE
        int "UART RX task stack size"
        default 4096 if IDF_TARGET_ESP32C5
        default 3072 if IDF_TARGET_ESP32H2
        default 3072
        range 2048 6144
        help
            Stack size for the UART receive task.

    config ZB_IO_BUFFER_SIZE
        int "Zigbee IO buffer size"
        default 256 if IDF_TARGET_ESP32C5
        default 192 if IDF_TARGET_ESP32H2
        default 192
        range 128 512
        help
            Size of the Zigbee IO buffer. Larger buffers allow for
            more concurrent operations.

    config ZB_BINDING_TABLE_SIZE
        int "Binding table size"
        default 64 if IDF_TARGET_ESP32C5
        default 32 if IDF_TARGET_ESP32H2
        default 32
        range 16 128
        help
            Maximum number of bindings. Each binding uses memory.

    config ZB_SCENE_TABLE_SIZE
        int "Scene table size"
        default 16 if IDF_TARGET_ESP32C5
        default 8 if IDF_TARGET_ESP32H2
        default 8
        range 4 32
        help
            Maximum number of scenes that can be stored.

    menu "Optional Features"

        config ZB_ENABLE_OTA
            bool "Enable OTA support"
            default y if IDF_TARGET_ESP32C5
            default n if IDF_TARGET_ESP32H2
            help
                Enable Over-The-Air firmware update support for Zigbee devices.
                Uses approximately 20KB additional flash/RAM. Disabled by
                default on H2 to save memory.

        config ZB_ENABLE_TOUCHLINK
            bool "Enable Touchlink commissioning"
            default y if IDF_TARGET_ESP32C5
            default n if IDF_TARGET_ESP32H2
            help
                Enable Touchlink commissioning support. Uses additional
                memory. Disabled by default on H2.

        config ZB_ENABLE_GREEN_POWER
            bool "Enable Green Power support"
            default y
            help
                Enable Green Power proxy support for battery-free devices.
                Recommended to keep enabled for device compatibility.

        config ZB_ENABLE_DIAGNOSTICS
            bool "Enable network diagnostics"
            default y if IDF_TARGET_ESP32C5
            default n if IDF_TARGET_ESP32H2
            help
                Enable detailed network diagnostics and statistics.
                Uses additional memory for tracking.

        config ZB_ENABLE_MULTI_PAN
            bool "Enable Multi-PAN support"
            default n
            help
                Enable experimental Multi-PAN support. Only useful if
                running both Zigbee and Thread on the same device.

    endmenu

    menu "Debug Options"

        config ZB_DEBUG_VERBOSE
            bool "Verbose debug logging"
            default n
            help
                Enable verbose debug logging for Zigbee operations.
                Increases log output significantly.

        config ZB_DEBUG_CLUSTER_DUMP
            bool "Dump cluster data on receive"
            default n
            help
                Log raw cluster data when messages are received.
                Useful for debugging device communication issues.

    endmenu

endmenu
```
